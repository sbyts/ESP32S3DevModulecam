#include "DisplayManager.h"
#include <Wire.h>
#include <Adafruit_GFX.h>
#include <Adafruit_SSD1306.h>
#include <WiFi.h>

Adafruit_SSD1306 display(SCREEN_WIDTH, SCREEN_HEIGHT, &Wire, OLED_RESET);

// Бітмапи іконок
const unsigned char epd_bitmap_wifi_on [] PROGMEM = { 0x03, 0xc0, 0x0f, 0xf0, 0x3c, 0x3c, 0x70, 0x0e, 0xc3, 0xc3, 0x0f, 0xf0, 0x1c, 0x38, 0x30, 0x0c, 0x03, 0xc0, 0x07, 0xe0, 0x00, 0x00, 0x01, 0x80, 0x03, 0xc0, 0x03, 0xc0, 0x01, 0x80, 0x01, 0x80 };
const unsigned char epd_bitmap_wifi_off [] PROGMEM = { 0x00, 0x00, 0x00, 0x00, 0x0c, 0x30, 0x06, 0x60, 0x03, 0xc0, 0x01, 0x80, 0x01, 0x80, 0x00, 0x00, 0x01, 0x80, 0x01, 0x80, 0x03, 0xc0, 0x06, 0x60, 0x0c, 0x30, 0x00, 0x00, 0x00, 0x00, 0x00, 0x00 };
const unsigned char epd_bitmap_cam_on [] PROGMEM = { 0x00, 0x00, 0x3f, 0xfc, 0x60, 0x06, 0x40, 0x02, 0x47, 0xe2, 0x4c, 0x32, 0x58, 0x1a, 0x50, 0x0a, 0x50, 0x0a, 0x58, 0x1a, 0x4c, 0x32, 0x47, 0xe2, 0x40, 0x02, 0x60, 0x06, 0x3f, 0xfc, 0x00, 0x00 };
const unsigned char epd_bitmap_cam_off [] PROGMEM = { 0x00, 0x00, 0x3f, 0xfc, 0x60, 0x06, 0x40, 0x02, 0x41, 0x82, 0x41, 0x82, 0x41, 0x82, 0x41, 0x82, 0x41, 0x82, 0x40, 0x02, 0x41, 0x82, 0x40, 0x02, 0x41, 0x82, 0x60, 0x06, 0x3f, 0xfc, 0x00, 0x00 };
const unsigned char epd_bitmap_motion_on [] PROGMEM = { 0x01, 0x80, 0x03, 0xc0, 0x03, 0xc0, 0x01, 0x80, 0x0f, 0xfe, 0x1c, 0x70, 0x38, 0x38, 0x30, 0x18, 0x1b, 0xd0, 0x0f, 0xe0, 0x07, 0xc0, 0x0e, 0xe0, 0x1c, 0x70, 0x38, 0x38, 0x70, 0x1c, 0xe0, 0x0f };
const unsigned char epd_bitmap_motion_off [] PROGMEM = { 0x00, 0x00, 0x00, 0x00, 0x03, 0xc0, 0x07, 0xe0, 0x0e, 0x70, 0x0c, 0x30, 0x0c, 0x30, 0x0c, 0x30, 0x0c, 0x30, 0x0c, 0x30, 0x0c, 0x30, 0x0e, 0x70, 0x07, 0xe0, 0x03, 0xc0, 0x00, 0x00, 0x00, 0x00 };

void initDisplay() {
    Wire.begin(OLED_SDA, OLED_SCL, 400000);
    if(!display.begin(SSD1306_SWITCHCAPVCC, 0x3C)) {
        Serial.println("[OLED] Помилка виділення пам'яті");
        while(true);
    }
    display.clearDisplay();
    display.setTextSize(1);
    display.setTextColor(SSD1306_WHITE);
    display.setCursor(15, 25);
    display.print("LOADING SYSTEM...");
    display.display();
}

void updateScreen(bool wifiOk, bool camOk, bool motionDetected) {
    display.clearDisplay();
    
    display.drawBitmap(15, 5, wifiOk ? epd_bitmap_wifi_on : epd_bitmap_wifi_off, 16, 16, SSD1306_WHITE);
    display.drawBitmap(56, 5, camOk ? epd_bitmap_cam_on : epd_bitmap_cam_off, 16, 16, SSD1306_WHITE);
    display.drawBitmap(96, 5, motionDetected ? epd_bitmap_motion_on : epd_bitmap_motion_off, 16, 16, SSD1306_WHITE);
    
    display.setTextSize(1);
    display.setTextColor(SSD1306_WHITE);
    display.setCursor(12, 25); display.print("NET");
    display.setCursor(53, 25); display.print("CAM");
    display.setCursor(93, 25); display.print("PIR");
    display.drawFastHLine(0, 38, 128, SSD1306_WHITE);
    display.setCursor(5, 48);

    if (WiFi.status() == WL_CONNECTED) {
        display.print("IP: " + WiFi.localIP().toString());
    } else if (WiFi.getMode() == WIFI_AP) {
        display.print("AP: 192.168.4.1:81");
    } else {
        display.print("IP: DISCONNECTED");
    }
    display.display();
}

void showCalibration(int secondsLeft) {
    display.clearDisplay();
    display.setTextSize(1); display.setTextColor(SSD1306_WHITE);
    display.setCursor(15, 15); display.print("CALIBRATING PIR");
    display.setCursor(45, 35); display.print(secondsLeft); display.print(" sec");
    display.display();
}